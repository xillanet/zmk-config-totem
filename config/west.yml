## config/west.yml
```yaml
manifest:
  remotes:
    - name: zmkfirmware
      url: https://github.com/zmkfirmware
    - name: bildermankawasaki
      url: https://github.com/bildermankawasaki
  projects:
    - name: zmk
      remote: zmkfirmware
      revision: v0.3
      import: app/west.yml
    - name: zmk-keyboard-totem
      remote: bildermankawasaki
      revision: main
  self:
    path: config
```
